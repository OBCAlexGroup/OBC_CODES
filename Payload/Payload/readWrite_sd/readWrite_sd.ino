/*
  SD card read/write

 This example shows how to read and write data to and from an SD card file
 The circuit:
 * SD card attached to SPI bus as follows:
 ** MOSI - pin 11
 ** MISO - pin 12
 ** CLK - pin 13
 ** CS - pin 4 (for MKRZero SD: SDCARD_SS_PIN)

 created   Nov 2010
 by David A. Mellis
 modified 9 Apr 2012
 by Tom Igoe

 This example code is in the public domain.

 */

#include <SPI.h>
#include <SD.h>

File myFile;
int i=0;
int j=0;
byte CameraData[512][16] = {{0xFF,0xD8,0xFF,0xE0,0x00,0x10,0x4A,0x46,0x49,0x46,0x00,0x01,0x01,0x01,0x00,0x48},
                          {0x00,0x48,0x00,0x00,0xFF,0xDB,0x00,0x43,0x00,0x02,0x02,0x02,0x02,0x02,0x02,0x02},
                          {0x02,0x02,0x02,0x02,0x02,0x02,0x02,0x03,0x03,0x03,0x02,0x02,0x03,0x03,0x04,0x03},
                          {0x03,0x03,0x03,0x03,0x04,0x05,0x04,0x04,0x04,0x04,0x04,0x04,0x05,0x05,0x06,0x06}
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                          {0x0A,0x0A,0x0A,0x0A,0x0A,0x0A,0x0A,0x0A,0x0A,0x0A,0x0A,0x0A,0x0A,0x0A,0x0A,0x0A}
                          {0x0A,0x0A,0x0A,0x0A,0x0A,0x0A,0x0A,0x0A.0x0A,0x0A,0x0A,0x0A,0x0A,0x0A,0xFF,0xC0}
                          {0x00,0x11,0x08,0x00,0x5E,0x00,0xB4,0x03,0x01,0x11,0x00,0x02,0x11,0x01,0x03,0x11}
                          {0x01,0xFF,0xC4,0x00,0x1E,0x00,0x00,0x01,0x04,0x03,0x01,0x01,0x01,0x00,0x00,0x00}
                          {0x00,0x00,0x00,0x00,0x00,0x00,0x00,0x05,0x06,0x07,0x08,0x03,0x04,0x09,0x01,0x02}
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                          {0x91,0x1F,0x38,0x32,0x59,0xB7,0x5D,0xA1,0xA4,0x59,0x00,0x04,0x2F,0x1B,0x8A,0xA2};
                         
                          

void setup() {
  // Open serial communications and wait for port to open:
  Serial.begin(9600);
  while (!Serial) {
    ; // wait for serial port to connect. Needed for native USB port only
  }


  Serial.print("Initializing SD card...");

  if (!SD.begin(10)) {
    Serial.println("initialization failed!");
    return;
  }
  Serial.println("initialization done.");

  // open the file. note that only one file can be open at a time,
  // so you have to close this one before opening another.
  myFile = SD.open("test8.txt", FILE_WRITE);

  // if the file opened okay, write to it:
  if (myFile) {
    Serial.println("Writing to test8.txt...");
    for (i=0;i<512;i++){
      for(j=0;j<16;j++){
        if(CameraData[i][j]<16){
          Serial.print("0");
          myFile.print("0");
          myFile.print(CameraData[i][j],HEX);
          Serial.print(CameraData[i][j],HEX);
          }
         else{
         myFile.print(CameraData[i][j],HEX);
         Serial.print(CameraData[i][j],HEX);
         }
        }
        myFile.println("");
        Serial.print("\n");
      
      
    }
    // close the file:
    myFile.close();
    Serial.println("done.");
  } else {
    // if the file didn't open, print an error:
    Serial.println("error opening test.txt");
  }

  // re-open the file for reading:
  myFile = SD.open("test8.txt");
  if (myFile) {
    Serial.println("test8.txt:");

    // read from the file until there's nothing else in it:
    while (myFile.available()) {
      Serial.write(myFile.read());
    }
    // close the file:
    myFile.close();
  } else {
    // if the file didn't open, print an error:
    Serial.println("error opening test.txt");
  }
}

void loop() {
  // nothing happens after setup
}
